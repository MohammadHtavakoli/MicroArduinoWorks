#include <Wire.h>
#include <Adafruit_GFX.h>
#include <Adafruit_SSD1306.h>
#include <Keypad.h>
#include <TM1637Display.h>
#include <RTClib.h>
#include <DHT.h>

// تنظیمات سخت‌افزاری
#define SCREEN_WIDTH 128       // عرض صفحه‌نمایش OLED
#define SCREEN_HEIGHT 64       // ارتفاع صفحه‌نمایش OLED
#define OLED_RESET -1          // پایه Reset برای OLED (در این مدل استفاده نمی‌شود)
#define CLKPIN 52              // پایه ساعت برای نمایشگر TM1637
#define DATAPIN 3              // پایه داده برای نمایشگر TM1637
#define DHTPIN 2               // پایه سنسور DHT
#define DHTTYPE DHT22          // نوع سنسور DHT (DHT22)

// تعریف آبجکت‌های سخت‌افزاری
Adafruit_SSD1306 display(SCREEN_WIDTH, SCREEN_HEIGHT, &Wire, OLED_RESET); // صفحه‌نمایش OLED
TM1637Display tm(CLKPIN, DATAPIN);  // نمایشگر TM1637
RTC_DS1307 rtc;                     // ماژول ساعت RTC
DHT dht(DHTPIN, DHTTYPE);           // سنسور دما و رطوبت DHT

// تنظیمات کی‌پد
const byte ROWS = 4;  // تعداد سطرهای کی‌پد
const byte COLS = 4;  // تعداد ستون‌های کی‌پد
char keys[ROWS][COLS] = {  // تعریف کلیدهای کی‌پد
  {'1','2','3','A'},
  {'4','5','6','B'},
  {'7','8','9','C'},
  {'*','0','#','D'}
};
byte rowPins[ROWS] = {22, 23, 24, 25}; // پایه‌های سطرهای کی‌پد
byte colPins[COLS] = {26, 27, 28, 29}; // پایه‌های ستون‌های کی‌پد
Keypad keypad = Keypad(makeKeymap(keys), rowPins, colPins, ROWS, COLS); // تعریف آبجکت کی‌پد

// متغیرهای قفل دستگاه
String password = "1234";      // رمز عبور پیش‌فرض
String inputPassword = "";     // رشته‌ای برای ذخیره رمز عبور وارد شده
bool isUnlocked = false;       // وضعیت قفل دستگاه
int currentMenu = 0;           // شماره منوی فعلی

// متغیرهای ماشین حساب
String calcInput = "";         // ورودی ماشین حساب
double result = 0;             // نتیجه محاسبات
char lastOperator = '\0';      // آخرین عملگر استفاده شده در محاسبات

// تعریف نقطه برای بازی
struct Point {  
  int x;                       // مختصات افقی
  int y;                       // مختصات عمودی
};

// تنظیمات و متغیرهای بازی مار
#define SNAKE_MAX_LENGTH 50    // حداکثر طول مار
#define SNAKE_PIECE_SIZE 2     // اندازه هر بخش از مار
#define STARTING_SNAKE_SIZE 3  // طول اولیه مار
#define SNAKE_MOVE_DELAY 200   // تاخیر در حرکت مار (بر حسب میلی‌ثانیه)
enum Direction { UP, RIGHT, DOWN, LEFT }; // جهت‌های ممکن برای حرکت مار
enum GameState { START, RUNNING, GAMEOVER }; // وضعیت‌های بازی

Point snake[SNAKE_MAX_LENGTH]; // آرایه‌ای برای ذخیره مختصات مار
int snakeLength;               // طول فعلی مار
Point fruit;                   // مختصات میوه
Direction dir, newDir;         // جهت فعلی و جهت جدید مار
GameState gameState = START;           // وضعیت فعلی بازی

unsigned long lastMoveTime = 0; // زمان آخرین حرکت مار
int moveInterval = 300;         // بازه زمانی بین حرکات مار

// متغیرهای کرنومتر
unsigned long stopwatchStartTime = 0; // زمان شروع کرنومتر
unsigned long stopwatchElapsedTime = 0; // مدت زمان سپری‌شده
bool stopwatchRunning = false;         // وضعیت روشن یا خاموش بودن کرنومتر


// my logo
const unsigned char logo_bitmap [] PROGMEM = {
	// 'Logo_128x64', 128x64px
	0xff, 0xff, 0xff, 0xff, 0xff, 0xff, 0xf5, 0x20, 0x09, 0x5f, 0xff, 0xff, 0xff, 0xff, 0xff, 0xff, 
	0xff, 0xff, 0xff, 0xff, 0xff, 0xf4, 0x00, 0x8a, 0xa2, 0x00, 0x5f, 0xff, 0xff, 0xff, 0xff, 0xff, 
	0xff, 0xff, 0xff, 0xff, 0xfd, 0x02, 0x94, 0x20, 0x08, 0xa2, 0x00, 0xbf, 0xff, 0xff, 0xff, 0xff, 
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	0x7f, 0xfe, 0xff, 0xff, 0xff, 0xff, 0xfa, 0x91, 0x05, 0x7f, 0xff, 0xff, 0xff, 0xff, 0xff, 0xff
};

// 'car ', 128x64px
const unsigned char car_bitmap [] PROGMEM = {
	0xff, 0xff, 0xff, 0xff, 0xff, 0xff, 0xff, 0xff, 0xff, 0xff, 0xff, 0xff, 0xff, 0xff, 0xff, 0xff, 
	0xff, 0xff, 0xff, 0xff, 0xff, 0xff, 0xff, 0xff, 0xff, 0xff, 0xff, 0xff, 0xff, 0xff, 0xff, 0xff, 
	0xff, 0xff, 0xff, 0xff, 0xff, 0xff, 0xff, 0xff, 0xff, 0xff, 0xff, 0xff, 0xff, 0xff, 0xff, 0xff, 
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	0x6c, 0xed, 0xf7, 0xfe, 0xef, 0x7f, 0xf6, 0xdb, 0xff, 0x7f, 0x76, 0xff, 0xdf, 0xf7, 0xfb, 0x7d
};

// 'rose', 128x64px
const unsigned char rose_bitmap [] PROGMEM = {
  0xff, 0xff, 0xff, 0xff, 0xff, 0xff, 0xff, 0xff, 0xff, 0xff, 0xff, 0xff, 0xff, 0xff, 0xff, 0xff, 
  0xff, 0xff, 0xff, 0xff, 0xff, 0xff, 0xfe, 0x00, 0x00, 0xff, 0xff, 0xff, 0xff, 0xff, 0xff, 0xff, 
  0xff, 0xff, 0xff, 0xff, 0xff, 0xff, 0xfd, 0xfe, 0x7f, 0x3f, 0xff, 0xff, 0xff, 0xff, 0xff, 0xff, 
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  0xff, 0xff, 0xff, 0xff, 0xff, 0xff, 0xff, 0xff, 0xff, 0xff, 0xff, 0xff, 0xff, 0xff, 0xff, 0xff
};

// 'cat', 128x64px
const unsigned char cat_bitmap [] PROGMEM = {
	0x00, 0x00, 0x00, 0x00, 0x00, 0x00, 0x00, 0x00, 0x00, 0x00, 0x00, 0x00, 0x00, 0x00, 0x00, 0x00, 
	0x00, 0x00, 0x00, 0x00, 0x00, 0x00, 0x00, 0x00, 0x00, 0x00, 0x00, 0x00, 0x00, 0x00, 0x00, 0x00, 
	0x00, 0x00, 0x00, 0x00, 0x00, 0x00, 0x00, 0x00, 0x00, 0x00, 0x00, 0x00, 0x00, 0x00, 0x00, 0x00, 
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	0x1f, 0xff, 0xff, 0xff, 0xff, 0xff, 0xff, 0xff, 0xff, 0xff, 0xff, 0xff, 0x00, 0x00, 0x00, 0x00
};

void setup() {
  Serial.begin(9600);

  // مقداردهی اولیه نمایشگر OLED
  if (!display.begin(SSD1306_SWITCHCAPVCC, 0x3C)) {
    Serial.println("OLED init failed!");
    while (true);
  }
  display.clearDisplay();
  display.setTextSize(1);
  display.setTextColor(SSD1306_WHITE);
  display.setCursor(0, 0);
  display.println("System Initializing...");
  
  display.display();
  showLogo();

  display.clearDisplay();
  display.setCursor(0, 0);
  display.println("System Ready!");
  display.display();
  delay(1000);

  // مقداردهی اولیه ماژول‌ها
  tm.setBrightness(0x0a);  // Set brightness (0x00 to 0x0f)
  rtc.begin();
  dht.begin();


  delay(2000);
}


void loop() {
  if (!isUnlocked) {
    lockScreen();  // صفحه قفل
  } else {
    switch (currentMenu) {
      case 0: showMenu(); break;       // نمایش منو
      case 1: showDistance(); break;  // فاصله‌سنج
      case 2: showTempHumidity(); break; // دما و رطوبت
      case 3: showTime(); break;      // ساعت
      case 4: showSnakeGame(); break;    // بازی
      case 5: showGallery(); break;   // گالری
      case 6: showCalculator(); break; // ماشین حساب
      case 7: showStopwatch(); break; // کرنومتر
    }
  }
}


// قفل صفحه
void lockScreen() {
  display.clearDisplay();
  display.setCursor(0, 0);
  display.println("Enter Password:");
  display.print(inputPassword);
  display.display();

  char key = keypad.getKey();
  if (key) {
    if (key == '#') {
      if (inputPassword == password) {
        isUnlocked = true;
        currentMenu = 0;
      } else {
        inputPassword = "";
        display.clearDisplay();
        display.println("Wrong Password!");
        display.display();
        delay(1000);
      }
    } else {
      inputPassword += key;
    }
  }
}

// نمایش منو
void showMenu() {
  display.clearDisplay();
  display.setCursor(0, 0);
  display.println("Menu:");
  display.println("1. Distance");
  display.println("2. Temp & Humidity");
  display.println("3. Time");
  display.println("4. Snake Game");
  display.println("5. Gallery");
  display.println("6. Calculator");
  display.println("7. Stopwatch");
  display.display();

  char key = keypad.getKey();
  if (key) {
    switch (key) {
      case '1': currentMenu = 1; break;
      case '2': currentMenu = 2; break;
      case '3': currentMenu = 3; break;
      case '4': currentMenu = 4; break;
      case '5': currentMenu = 5; break;
      case '6': currentMenu = 6; break;
      case '7': currentMenu = 7; break;
      case 'B': isUnlocked = false; inputPassword = ""; break;
    }
  }
}


// اندازه‌گیری فاصله
void showDistance() {
  long duration;
  int distance;

  pinMode(4, OUTPUT);  // Trigger pin
  pinMode(5, INPUT);   // Echo pin

  digitalWrite(4, LOW);
  delayMicroseconds(2);
  digitalWrite(4, HIGH);
  delayMicroseconds(10);
  digitalWrite(4, LOW);

  duration = pulseIn(5, HIGH);
  distance = duration * 0.034 / 2;

  display.clearDisplay();
  display.setCursor(0, 0);
  display.println("Distance:");
  display.print(distance);
  display.println(" cm");
  display.display();
  char key = keypad.getKey();
  if (key == 'B') {
    currentMenu = 0; // بازگشت به منو
    return;
  }
  delay(1000);
}

// نمایش دما و رطوبت
void showTempHumidity() {
  
  float temp = dht.readTemperature();
  float humidity = dht.readHumidity();

  if (isnan(temp) || isnan(humidity)) {
    display.clearDisplay();
    display.println("Sensor Error!");
    display.display();
    return;
  }

  display.clearDisplay();
  display.setCursor(0, 0);
  display.println("Temperature:");
  display.print(temp);
  display.println(" C");
  display.println("Humidity:");
  display.print(humidity);
  display.println(" %");
  display.display();
  char key = keypad.getKey();
  if (key == 'B') {
    currentMenu = 0; // بازگشت به منو
    return;
  }
  delay(1000);
}

// نمایش ساعت
void showTime() {
  DateTime now = rtc.now();

  display.clearDisplay();
  display.setCursor(0, 0);
  display.println("Current Time:");
  display.print(now.hour());
  display.print(":");
  display.println(now.minute());
  display.display();

  // نمایش زمان روی TM1637
  int hours = now.hour();
  int minutes = now.minute();

  // فرمت ساعت و دقیقه به صورت دو رقمی
  int timeDisplay = (hours % 24) * 100 + minutes; // محدودیت ساعت به ۲۴ ساعت
  tm.showNumberDecEx(timeDisplay, 0b01000000, true); // نمایش به صورت HH:MM

  char key = keypad.getKey();
  if (key == 'B') {
    currentMenu = 0; // بازگشت به منو
    return;
  }
  delay(1000);
}

// گالری تصاویر
void showGallery() {
  while (true) {
    // نمایش منوی گالری
    display.clearDisplay();
    display.setTextSize(1);
    display.setTextColor(SSD1306_WHITE);
    display.setCursor(0, 0);
    display.println("Gallery:");
    display.println("1. Car");
    display.println("2. Rose");
    display.println("3. Cat");
    display.display();

    // خواندن دکمه فشرده شده
    char key = keypad.getKey();
    if (key) {
      if (key == '1') {
        // نمایش تصویر ماشین
        display.clearDisplay();
        display.drawBitmap(0, 0, car_bitmap, 128, 64, SSD1306_WHITE);
        display.display();

        // منتظر بمان تا کاربر دکمه B را فشار دهد
        while (true) {
          key = keypad.getKey();
          if (key == 'B') {
            break; // برگشت به منوی گالری
          }
          delay(100); // تأخیر کوچک برای جلوگیری از خواندن سریع کی‌پد
        }
      } else if (key == '2') {
        // نمایش تصویر گل
        display.clearDisplay();
        display.drawBitmap(0, 0, rose_bitmap, 128, 64, SSD1306_WHITE);
        display.display();

        // منتظر بمان تا کاربر دکمه B را فشار دهد
        while (true) {
          key = keypad.getKey();
          if (key == 'B') {
            break; // برگشت به منوی گالری
          }
          delay(100); // تأخیر کوچک برای جلوگیری از خواندن سریع کی‌پد
        }
      } else if (key == '3') {
        // نمایش تصویر گربه
        display.clearDisplay();
        display.drawBitmap(0, 0, cat_bitmap, 128, 64, SSD1306_WHITE);
        display.display();

        // منتظر بمان تا کاربر دکمه B را فشار دهد
        while (true) {
          key = keypad.getKey();
          if (key == 'B') {
            break; // برگشت به منوی گالری
          }
          delay(100); // تأخیر کوچک برای جلوگیری از خواندن سریع کی‌پد
        }
      } else if (key == 'B') {
        // بازگشت به منوی اصلی
        currentMenu = 0;
        return;
      }
    }
    delay(10); // تأخیر کوچک برای جلوگیری از خواندن سریع کی‌پد
  }
}
// تابع برای نمایش لوگو در ابتدای کار
void showLogo(void) {
  display.clearDisplay();

  display.drawBitmap(
    (display.width() - 128) / 2,
    (display.height() - 64) / 2, 
    logo_bitmap, 128, 64, 1);
  display.display();
  delay(2000);
}
// نمایش بازی ماری
void showSnakeGame() {
  // Initialize the game
  setupGame();
  unsigned long lastMoveTime = 0;

  while (true) {
    unsigned long currentTime = millis();
    char key = keypad.getKey(); // خواندن کلید فشار داده شده

    switch (gameState) {
      case START:
        display.clearDisplay();
        drawMap();
        drawScore();
        drawPressToStart();
        display.display();
        if (buttonPress()) {
          gameState = RUNNING;
          delay(200); // Debounce delay
        }
        break;

      case RUNNING:
        if (currentTime - lastMoveTime >= SNAKE_MOVE_DELAY) {
          dir = newDir; // Update the direction
          if (moveSnake()) {
            gameState = GAMEOVER; // Collision detected, game over
            break;
          }
          checkFruit();
          display.clearDisplay();
          drawMap();
          drawScore();
          display.display();
          lastMoveTime = currentTime;
        }
        readDirection(); // Read user input from keypad
        break;

      case GAMEOVER:
        display.clearDisplay();
        drawGameover();
        display.display();

        // اگر دکمه A فشار داده شد، بازی ریست شود
        if (key == 'A') {
          delay(500); // Debounce delay
          setupGame(); // Reset the game
          gameState = RUNNING; // Start the game again
        }
        // اگر دکمه B فشار داده شد، به منوی اصلی بازگرد
        else if (key == 'B') {
          delay(500); // Debounce delay
          currentMenu = 0;
          return; // Exit the game and return to the main menu
        }
        break;
    }

    delay(10); // General loop delay for responsiveness
  }
}
// تابع حرکت مار 
bool moveSnake() {
  // محاسبه موقعیت جدید سر مار
  int newX = snake[0].x;
  int newY = snake[0].y;

  switch (dir) {
    case UP:    newY--; break;
    case DOWN:  newY++; break;
    case LEFT:  newX--; break;
    case RIGHT: newX++; break;
  }

  // بررسی برخورد با دیوار یا خود مار
  if (collisionCheck(newX, newY)) {
    return true; // برخورد رخ داده است
  }

  // حرکت مار به موقعیت جدید
  for (int i = snakeLength - 1; i > 0; i--) {
    snake[i] = snake[i - 1]; // هر قطعه به موقعیت قطعه قبلی می‌رود
  }
  snake[0] = {newX, newY}; // سر مار به موقعیت جدید می‌رود

  return false; // هیچ برخوردی رخ نداده است
}
// تابع برای تنظیمات بازی 
void setupGame() {
  gameState = START;
  dir = RIGHT;
  newDir = RIGHT;
  resetSnake();
  generateFruit();
  display.clearDisplay();
  drawMap();
  drawScore();
  drawPressToStart();
  display.display();
}
// تابع برای ریستارت بازی
void resetSnake() {
  snakeLength = STARTING_SNAKE_SIZE;
  for (int i = 0; i < snakeLength; i++) {
    snake[i] = {SCREEN_WIDTH / 4 - i, SCREEN_HEIGHT / 4};
  }
}
// تابع برای چک کردن میوه
void checkFruit() {
  if (snake[0].x == fruit.x && snake[0].y == fruit.y) {
    if (snakeLength < SNAKE_MAX_LENGTH) snake[snakeLength++] = snake[snakeLength - 1];
    generateFruit();
  }
}
// تابع برای تولید میوه
void generateFruit() {
  bool valid;
  do {
    valid = true;
    fruit = {random(0, SCREEN_WIDTH / SNAKE_PIECE_SIZE), random(0, SCREEN_HEIGHT / SNAKE_PIECE_SIZE)};
    for (int i = 0; i < snakeLength; i++) {
      if (snake[i].x == fruit.x && snake[i].y == fruit.y) {
        valid = false;
        break;
      }
    }
  } while (!valid);
}
// چک کردن برخورد با دیوار یا  خود مار 
bool collisionCheck(int x, int y) {
  // بررسی برخورد با دیوار
  if (x < 0 || y < 0 || x >= SCREEN_WIDTH / SNAKE_PIECE_SIZE || y >= SCREEN_HEIGHT / SNAKE_PIECE_SIZE) {
    return true; // برخورد با دیوار
  }

  // بررسی برخورد با خود مار
  for (int i = 1; i < snakeLength; i++) {
    if (snake[i].x == x && snake[i].y == y) {
      return true; // برخورد با خود مار
    }
  }

  return false; // هیچ برخوردی رخ نداده است
}
// تابع برای مپ بازی 
void drawMap() {
  for (int i = 0; i < snakeLength; i++) {
    display.fillRect(snake[i].x * SNAKE_PIECE_SIZE, snake[i].y * SNAKE_PIECE_SIZE, SNAKE_PIECE_SIZE, SNAKE_PIECE_SIZE, SSD1306_WHITE);
  }
  display.fillRect(fruit.x * SNAKE_PIECE_SIZE, fruit.y * SNAKE_PIECE_SIZE, SNAKE_PIECE_SIZE, SNAKE_PIECE_SIZE, SSD1306_INVERSE);
}
// تابع برای نشان دادن امتیاز در بازی
void drawScore() {
  display.setTextSize(1);
  display.setTextColor(SSD1306_WHITE);
  display.setCursor(0, 0);
  display.print("Score: ");
  display.print(snakeLength - STARTING_SNAKE_SIZE);
}
// تابع برای نمایش پیام یکی از دکمه ها را فشار دهید
void drawPressToStart() {
  display.setTextSize(1);
  display.setTextColor(SSD1306_WHITE);
  display.setCursor(10, 30);
  display.print("Press a button");
  display.setCursor(10, 40);
  display.print("to start!");
}
// تابع برای نمایش پیام گیم اوور
void drawGameover() {
  display.clearDisplay();
  display.setTextSize(1);
  display.setTextColor(SSD1306_WHITE);
  display.setCursor(20, 10);
  display.println("GAME OVER");
  display.setCursor(10, 20);
  display.println("Press A to restart");
  display.setCursor(10, 30);
  display.println("Press B to exit");
  display.display();
}

// آپدیت دکمه فشرده شده با این تابع در بازی
bool buttonPress() {
  char key = keypad.getKey();
  return key != NO_KEY; // Return true if any key is pressed
}
// آپدیت موقعیت مار در بازی با این تابع
void readDirection() {
  char key = keypad.getKey();
  if (key) {
    switch (key) {
      case '2': if (dir != DOWN) newDir = UP; break;    // Up
      case '6': if (dir != LEFT) newDir = RIGHT; break; // Right
      case '8': if (dir != UP) newDir = DOWN; break;    // Down
      case '4': if (dir != RIGHT) newDir = LEFT; break; // Left
    }
  }
}

// کنترل ماشین حساب
void showCalculator() {
  display.clearDisplay();
  display.setTextSize(1);
  display.setTextColor(SSD1306_WHITE);
  display.setCursor(0, 0);
  display.println("Calculator:");

  // نمایش ورودی و نتیجه
  display.setCursor(0, 20);
  display.print("Input: ");
  display.println(calcInput);
  display.setCursor(0, 40);
  display.print("Result: ");
  display.println(result, 4); // نمایش نتیجه با ۴ رقم اعشار

  display.display();

  // کنترل ماشین حساب
  char key = keypad.getKey();
  if (key) {

    if (key == 'B') { // بازگشت به منوی اصلی
      currentMenu = 0;
      calcInput = "";
      result = 0;
      lastOperator = '\0';
      return;
    } else if (key == 'A') { // عملگر جمع (+)
      if (calcInput.length() > 0) {
        calcInput += '+';
      }
    } else if (key == '*') { // عملگر ضرب (*)
      if (calcInput.length() > 0) {
        calcInput += '*';
      }
    } else if (key == '#') { // انجام محاسبه و نمایش نتیجه
      calculateResult();
    } else if (key == 'D') { // پاک کردن آخرین کاراکتر
      if (calcInput.length() > 0) {
        calcInput.remove(calcInput.length() - 1);
      }
    } else if (key == 'C') { // عملگر تفریق (-)
      if (calcInput.length() > 0) {
        calcInput += '-';
      }
    } else if (key >= '0' && key <= '9' || key == '.') { // اعداد و نقطه اعشار
      calcInput += key;
    }

    // به‌روزرسانی نمایشگر پس از هر تغییر
    display.clearDisplay();
    display.setCursor(0, 0);
    display.println("Calculator:");
    display.setCursor(0, 20);
    display.print("Input: ");
    display.println(calcInput);
    display.setCursor(0, 40);
    display.print("Result: ");
    display.println(result, 4);
    display.display();
  }
}

// انجام محاسبات
void calculateResult() {
  double num1 = 0, num2 = 0;
  char op = '\0';
  int opIndex = -1;

  // پیدا کردن عملگر
  for (int i = 0; i < calcInput.length(); i++) {
    if (calcInput[i] == '+' || calcInput[i] == '-' || calcInput[i] == '*' || calcInput[i] == '/') {
      op = calcInput[i];
      opIndex = i;
      break;
    }
  }

  if (opIndex == -1) { // اگر عملگر وجود نداشته باشد
    result = calcInput.toDouble();
    return;
  }

  // جدا کردن اعداد
  num1 = calcInput.substring(0, opIndex).toDouble();
  num2 = calcInput.substring(opIndex + 1).toDouble();

  // انجام محاسبه
  switch (op) {
    case '+': result = num1 + num2; break;
    case '-': result = num1 - num2; break;
    case '*': result = num1 * num2; break;
  }

  // نمایش نتیجه
  calcInput = String(result, 4); // نمایش نتیجه با ۴ رقم اعشار
}
// تابع کرنومتر 
void showStopwatch() {
  display.clearDisplay();
  display.setTextSize(1);
  display.setTextColor(SSD1306_WHITE);
  display.setCursor(0, 0);
  display.println("Stopwatch:");

  // محاسبه زمان سپری شده
  if (stopwatchRunning) {
    stopwatchElapsedTime = millis() - stopwatchStartTime;
  }

  // نمایش زمان روی OLED
  display.setCursor(0, 20);
  display.print("Time: ");
  display.println(formatTime(stopwatchElapsedTime));
  display.display();

  // نمایش زمان روی 7-Segment
  unsigned long totalSeconds = stopwatchElapsedTime / 1000;
  unsigned long minutes = totalSeconds / 60;
  unsigned long seconds = totalSeconds % 60;
  tm.showNumberDecEx(minutes * 100 + seconds, 0b01000000, true); // نمایش به صورت MM:SS

  // کنترل کرنومتر با کی‌پد
  char key = keypad.getKey();
  if (key) {
    if (key == 'A') { // شروع یا ادامه کرنومتر
      stopwatchRunning = true;
      stopwatchStartTime = millis() - stopwatchElapsedTime;
    } else if (key == 'C') { // توقف کرنومتر
      stopwatchRunning = false;
    } else if (key == 'D') { // ریست کرنومتر
      stopwatchRunning = false;
      stopwatchElapsedTime = 0;
      tm.showNumberDecEx(0, 0b01000000, true); // ریست 7-Segment
    } else if (key == 'B') { // بازگشت به منو
      currentMenu = 0;
      return;
    }
  }
}
// تابع برای فرمت زمان به فرم MM:SS:MS 
String formatTime(unsigned long time) {
  unsigned long minutes = time / 60000;
  unsigned long seconds = (time / 1000) % 60;
  unsigned long milliseconds = time % 1000;

  char buffer[12];
  sprintf(buffer, "%02lu:%02lu:%03lu", minutes, seconds, milliseconds);
  return String(buffer);
}